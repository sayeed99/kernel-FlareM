## arch/x86/hotplug/Kconfig
```kconfig
config ASMP
	bool "Multi-core automatic hotplug support"
	depends on SMP && HOTPLUG_CPU
	default y
	help
	  Automatically hotplugs the multiple cpu cores on and off
	  based on cpu load and suspend state

config ALUCARD_HOTPLUG
	bool "Enable alucard-hotplug cpu hotplug driver"
	default y
	help
	  Alucard-hotplug cpu hotplug driver

config INTELLI_PLUG
	   bool "Hotplug for Razor Reborn"
	   depends on SMP
	   default y
	   help
		 This enables kernel based multi core control.
```

## drivers/cpufreq/Kconfig.OC
```kconfig
config CPU_ATOM_OVERCLOCK
	bool "Enable CPU Overclocking option"
	default n
	help
	  atom overclocking up to 2.5 GHz

config CPU_ATOM_UNDERCLOCK
	bool "Enable CPU Underclocking option"
	default n
	help
	  atom underclocking to 333 MHz
```
